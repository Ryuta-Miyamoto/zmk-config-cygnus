/*
 * Copyright (c) 2024 The ZMK Contributors
 *
 * SPDX-License-Identifier: MIT
 */

#include "cygnus3x5_xiao.dtsi"

&default_transform {
    col-offset = <5>;
};

/*
 * Left and right PCBs are the same design (mirrored), so the right
 * half's col-gpios are the reverse of the left half's - same pattern
 * used by the upstream corne shield.
 */
&kscan0 {
    col-gpios
        = <&gpio0 5 GPIO_ACTIVE_HIGH>    // D5 - Col0
        , <&gpio0 4 GPIO_ACTIVE_HIGH>    // D4 - Col1
        , <&gpio0 29 GPIO_ACTIVE_HIGH>   // D3 - Col2
        , <&gpio0 28 GPIO_ACTIVE_HIGH>   // D2 - Col3
        , <&gpio0 3 GPIO_ACTIVE_HIGH>    // D1 - Col4
        ;
};
