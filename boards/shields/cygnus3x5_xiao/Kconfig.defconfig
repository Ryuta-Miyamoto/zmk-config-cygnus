## boards/shields/cygnus3x5_xiao/Kconfig.defconfig
```kconfig
if SHIELD_CYGNUS3X5_XIAO_LEFT

config ZMK_KEYBOARD_NAME
    default "Cygnus 3x5"

config ZMK_SPLIT_ROLE_CENTRAL
    default y

endif

if SHIELD_CYGNUS3X5_XIAO_LEFT || SHIELD_CYGNUS3X5_XIAO_RIGHT

config ZMK_SPLIT
    default y

endif
```
